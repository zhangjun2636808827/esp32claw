## sdkconfig.defaults
```kconfig
# esp32claw - Common Default Configuration
# Target-specific settings are in sdkconfig.defaults.esp32s3

# Network hostname
CONFIG_LWIP_LOCAL_HOSTNAME="esp32claw"

# SPIFFS: increase max filename length (default 32 is too short for session files)
CONFIG_SPIFFS_OBJ_NAME_LEN=64
```
